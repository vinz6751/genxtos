MEMORY
{
    stram : ORIGIN = 0x00000000, LENGTH = 14M
    rom : ORIGIN = 0x00e00000, LENGTH = 1M
}
REGION_ALIAS("REGION_RAM", stram)
REGION_ALIAS("REGION_READ_ONLY", rom)
REGION_ALIAS("REGION_READ_WRITE", REGION_RAM)
